// Compiled Arduino 1.8.11
// Test Jukebox Monotone
// PAD ATARI and CPC Button 1 and 2
// Output NTSC video using the UART in SPI master mode on Arduino Uno.
// 40x25 character buffer is rasterized and scanned out in real-time.
// 320X200 pixels out of 1000 RAM bytes and 1K Flash character ROM.
// VIDEO on pin 1 (470 ohm resistor), SYNC on pin 9 (1K ohm resistor).
// Original source Dave Schmenk
// Mod by ackerman (Jaime Jose Gavin Sierra)
// No interrupts Hide video perfect sound
// Interrupt Show video, ntsc hsync 63.55 micro seconds audio
// LEFT, RIGHT    Last, next track
// UP, DOWN       +, - volumen
// A              Play/Pause
// B              Video, No Video audio interrupt or ntsc hsync
#define _use_gamepad_ataridb9

#ifdef _use_gamepad_ataridb9
#define pin_ataridb9_up 14
#define pin_ataridb9_down 15
#define pin_ataridb9_left 16
#define pin_ataridb9_right 17
//boton 2
#define pin_ataridb9_a 4
//boton 1
#define pin_ataridb9_b 5
#endif

#define pin_audio 6

//
// Timing settings for NTSC
//
#define _CYCLES_PER_US          (F_CPU / 1000000)
#define _TIME_HSYNC             4.7
#define _TIME_VSYNC             58.85
#define _TIME_ACTIVE            46
#define _CYCLES_VSYNC           ((_TIME_VSYNC * _CYCLES_PER_US) - 1)
#define _CYCLES_HSYNC           ((_TIME_HSYNC * _CYCLES_PER_US) - 1)
#define _NTSC_TIME_SCANLINE      63.55
#define _NTSC_TIME_OUTPUT_START  12
#define _NTSC_LINE_FRAME         262
#define _NTSC_LINE_START_VSYNC   0
#define _NTSC_LINE_STOP_VSYNC    3
#define _NTSC_LINE_DISPLAY       216
#define _NTSC_LINE_MID           ((_NTSC_LINE_FRAME - _NTSC_LINE_DISPLAY)/2 + _NTSC_LINE_DISPLAY/2 + _NTSC_LINE_STOP_VSYNC)
#define _NTSC_CYCLES_SCANLINE    ((_NTSC_TIME_SCANLINE * _CYCLES_PER_US) - 1)
#define _NTSC_CYCLES_OUTPUT_START ((_NTSC_TIME_OUTPUT_START * _CYCLES_PER_US) - 1)
//
// video = UART SPI TX
//
#define PORT_VID     PORTD
#define	DDR_VID     DDRD
#define	VID_PIN     1
#define XCK0_DDR     DDRD
#define XCK0         4
//
// sync = OC1A
//
#define PORT_SYNC    PORTB
#define DDR_SYNC     DDRB
#define SYNC_PIN     1
//
// video buffer
//
#define VID_WIDTH    40
#define VID_HEIGHT   25
#define CELL_WIDTH   8
#define CELL_HEIGHT  8
byte xpos = 0;
byte ypos = 0;
char videomem[VID_WIDTH * VID_HEIGHT];

byte antes_left,ahora_left;
byte antes_right,ahora_right;
byte antes_up,ahora_up;
byte antes_down,ahora_down;
byte antes_a,ahora_a;
byte antes_b,ahora_b;
//char cad_buffer[10];
bool gb_playPause = false;
bool gb_use_video_sound = true;
//unsigned long gb_time;

//
// rendering values
//

char *videoptr = videomem;
volatile int scanline = 0;
void (*line_handler)(void) = &blank_line;
volatile byte vblank = 0;
//
// character definitions
//
PROGMEM const byte charROM [1024] = {
0x00,0xF0,0x0F,0xFF,0x00,0xF0,0x0F,0xFF,0x00,0xF0,0x0F,0xFF,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0xAA,
0x00,0xF0,0x0F,0xFF,0x00,0xF0,0x0F,0xFF,0x00,0xF0,0x0F,0xFF,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0x55,
0x00,0xF0,0x0F,0xFF,0x00,0xF0,0x0F,0xFF,0x00,0xF0,0x0F,0xFF,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0xAA,
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0x00,0x00,0x00,0x00,0xF0,0xF0,0xF0,0xF0,0x0F,0x0F,0x0F,0x0F,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0x55
};

//30x25
PROGMEM const byte img_floppy[750] ={
0x16,0x1A,0x1A,0x1A,0x1E,0x1A,0x1A,0x1A,0x1A,0x1A,0x1A,0x1A,0x1A,0x1A,0x1A,0x1A,0x1A,0x1A,0x1A,0x1A,0x1A,0x1A,0x1A,0x1A,0x1A,0x1E,0x1A,0x1A,0x1A,0x1C,
0x0F,0x0F,0x0F,0x0F,0x15,0x00,0x1A,0x1A,0x1A,0x1A,0x1A,0x1A,0x1A,0x1A,0x1A,0x1A,0x1A,0x1A,0x1A,0x1A,0x1A,0x1A,0x1A,0x1A,0x00,0x15,0x0F,0x0F,0x0F,0x0F,
0x0F,0x20,0x20,0x0F,0x15,0x00,0x1A,0x1A,0x1A,0x1A,0x1A,0x1A,0x1A,0x1A,0x1A,0x1A,0x1A,0x1A,0x1A,0x1A,0x1A,0x1A,0x1A,0x1A,0x00,0x15,0x0F,0x7F,0x7F,0x0F,
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0x20,0x03,0x0F,0x0F,0x0F,0x0F,0x03,0x7F,0x7F,0x7F,0x7F,0x7F,0x7F,0x7F,0x7F,0x7F,0x7F,0x7F,0x7F,0x7F,0x7F,0x7F,0x7F,0x7F,0x5F,0x5F,0x0F,0x0F,0x0F,0x03
};


int gb_track_player_select = 0;
int gb_track_player_select_antes = 0; //antes de enviar



void Genera1000HzNoInterrupt()
{
 int antes;
 antes = scanline;
 while (scanline == antes);
 for (register word i=0;i<2000;i++)//Estoy en comienzo de temporizacion
 {
  PORTD |= _BV(6);
  for (register byte j=0;j<8;j++){
   antes = scanline;   
   while (scanline == antes);
  }
  PORTD &= ~_BV (6);
  for (register byte j=0;j<8;j++){
   antes = scanline;   
   while (scanline == antes);
  } 
 }
}

//void Genera1000HzInterrupt()
//{
// noInterrupts();
// for (register word i=0;i<2000 ;i++) //2 segundos
// {
//  PORTD |= _BV(6);     
//  delayMicroseconds(500);
//  PORTD &= ~_BV (6);     
//  delayMicroseconds(500);
// }   
// interrupts();
//}

//optimize not to use sprintf
void ShowTrack()
{
 char *cadAux;
 //sprintf(cad_buffer, " Track %d ",gb_track_player_select);
 switch (gb_track_player_select)
 {
  case 0: cadAux = "00"; break;
  case 1: cadAux = "01"; break;
  case 2: cadAux = "02"; break;
  case 3: cadAux = "03"; break;
  case 4: cadAux = "04"; break;
  case 5: cadAux = "05"; break;
  case 6: cadAux = "06"; break;
  case 7: cadAux = "07"; break;
  case 8: cadAux = "08"; break;
  case 9: cadAux = "09"; break;
  case 10: cadAux = "10"; break;
  default: cadAux = "00"; break;
 }
 gotoxy(21,3);
 printstr(cadAux);
}

void ShowPlayPause()
{
 gotoxy(14,7);
 if (gb_playPause == true){     
  printstr(" Play  ");
 }
 else{
  printstr(" Pause ");
 }
}

void ShowInterrupt()
{
 gotoxy(14,9);
 if (gb_use_video_sound == true){     
  printstr(" Video    ");
 }
 else{
  printstr(" No Video ");
 }
}


//void SoundWithInterrupt(char num)
void SoundWithInterrupt(char *cadNum)
{
 //Dividimos entre 63.55 microseconds
 int antes; 
 byte auxPulse;
 word bucle;
 for (byte i=0;i<strlen(cadNum);i++)
 {
  switch (cadNum[i])
  {
   case '0': auxPulse = 6; bucle = 668; break; //1336 374,25149700599/63,55 = 5,8890872856961447678992918961448 = 6
   case '1': auxPulse = 11; bucle = 348; break; //697 717,36011477762/63,55 = 11,288121396972777340676632572777 = 11 
   case '4': auxPulse = 10; bucle = 385; break; //770 649,35064935065/63,55 = 10,217948848948072383949645948072 = 10    
   case '7': auxPulse = 9; bucle = 426; break; //852  586,8544600939/63,55 = 9,2345312367254130605822187254131 = 9  
   case 'D': auxPulse = 5; bucle = 816; break; //1633 306,18493570116/63,55 = 4,8180162974218725413060582218725 = 5

   //case '2': auxPulse = 7; bucle = 606; break; //1209 413,56492969396/63,55 = 6,5077093578907946498819826907946 = 7  
   //case '#': auxPulse = 5; bucle = 740; break; //1477 Hz 338,5240352065/63.55 = 5,3268927648544453186467348544453 = 5
   //case '*': auxPulse = 8; bucle = 472; break; //941  531,34962805526/63.55 = 8,3611271133793863099921321793863 = 8  
  
   case '#': auxPulse = 14; bucle = 281; break; //561,98718669215 Hz 889,7/63.55 = 14
   case '*': auxPulse = 20; bucle = 197; break; //393,3910306845 Hz 1271/63.55 = 20
   case '2': auxPulse = 26; bucle = 151; break; //302,60848514192 Hz 1652,3/63.55 = 26
   default: break;
  }

  antes = scanline; 
  while (scanline == antes);
  for (register word i=0;i<bucle;i++)//Estoy en comienzo de temporizacion
  {
   PORTD |= _BV(6);
   for (register byte j=0;j<auxPulse;j++){
    antes = scanline;   
    while (scanline == antes);
   }
   PORTD &= ~_BV (6);
   for (register byte j=0;j<auxPulse;j++){
    antes = scanline;   
    while (scanline == antes);
   } 
  }

  //500000 / 63.55 = 7867,8206136900078678206136900079 500 millis
  for (register word i=0;i<7868;i++){  
   antes = scanline;   
   while (scanline == antes);
  } //Silencio 500 ms

 } 
}

//void SoundNoInterrupt(char num)
void SoundNoInterrupt(char * cadNum)
{
 word auxPulse;
 word bucle; 
for (byte i=0;i<strlen(cadNum);i++)
{ 
 switch (cadNum[i])
 {
  case '0': auxPulse = 374; bucle = 668; break; //1336 374,25149700599
  case '1': auxPulse = 717; bucle = 348; break; //697  717,36011477762
  case '2': auxPulse = 414; bucle = 606; break; //1209 413,56492969396
  case '4': auxPulse = 649; bucle = 385; break; //770  649,35064935065
  case '7': auxPulse = 587; bucle = 426; break; //852  586,8544600939
  case 'D': auxPulse = 306; bucle = 816; break; //1633 306,18493570116
  case '#': auxPulse = 339; bucle = 740; break; //1477 338,5240352065
  case '*': auxPulse = 531; bucle = 472; break; //941  531,34962805526  
 }
 for (register word i=0;i<bucle;i++) //1209
 {
  PORTD |= _BV(6);     
  delayMicroseconds(auxPulse);
  PORTD &= ~_BV (6);     
  delayMicroseconds(auxPulse);
 }   
    
 for (register byte i=0;i<50;i++){ delayMicroseconds (10000); } //Silencio 500 ms
}
}

void SoundPlayPause()
{
 if (gb_use_video_sound == true)
 {
  //SoundWithInterrupt('#');SoundWithInterrupt('2'); SoundWithInterrupt('2'); SoundWithInterrupt('*');//Play Pause 
  SoundWithInterrupt("#22*");//Play Pause 
 }
 else
 {
  noInterrupts();
  //SoundNoInterrupt('#');SoundNoInterrupt('2'); SoundNoInterrupt('2'); SoundNoInterrupt('*');//Play Pause  
  SoundNoInterrupt("#22*");//Play Pause  
  interrupts(); 
 }
}

void SoundVol(bool subirVol)
{
 if (gb_use_video_sound == true)
 {
  if (subirVol == true){
   //SoundWithInterrupt('#');SoundWithInterrupt('1'); SoundWithInterrupt('7');SoundWithInterrupt('*'); //+        
   SoundWithInterrupt("#17*");//+        
  }
  else{
   //SoundWithInterrupt('#');SoundWithInterrupt('1'); SoundWithInterrupt('D');SoundWithInterrupt('*'); //-
   SoundWithInterrupt("#1D*");//-
  }
 }
 else
 {
  noInterrupts();
  if (subirVol == true){
   //SoundNoInterrupt('#');SoundNoInterrupt('1'); SoundNoInterrupt('7');SoundNoInterrupt('*'); //+         
   SoundNoInterrupt("#17*"); //+
  }
  else{
   //SoundNoInterrupt('#');SoundNoInterrupt('1'); SoundNoInterrupt('D');SoundNoInterrupt('*'); //-  
   SoundNoInterrupt("#1D*");//-
  }
  interrupts();
 }
}

void SoundTrack()
{
  //PORTD |= _BV (0); // digitalWrite (0, HIGH);
  //PORTD &= ~_BV (0); // digitalWrite (0, LOW);
   
   //01 1336 697
   if (gb_track_player_select_antes != gb_track_player_select)
   {
    gb_track_player_select_antes = gb_track_player_select;
    if (gb_use_video_sound == true)
    {
     SoundWithInterrupt("#");    
     switch (gb_track_player_select)
     {
      case 0: SoundWithInterrupt("00"); break;
      case 1: SoundWithInterrupt("01"); break;
      case 2: SoundWithInterrupt("02"); break;
      case 3: SoundWithInterrupt("04"); break;
      case 4: SoundWithInterrupt("07"); break;
      case 5: SoundWithInterrupt("0D"); break;
      case 6: SoundWithInterrupt("10"); break;
      case 7: SoundWithInterrupt("11"); break;
      case 8: SoundWithInterrupt("12"); break;
      case 9: SoundWithInterrupt("14"); break;
      case 10: SoundWithInterrupt("24"); break;
      default: break;
     }
     SoundWithInterrupt("*");          
    }
    else
    {    
     noInterrupts();    
     SoundNoInterrupt("#");    
     switch (gb_track_player_select)
     {
      case 0: SoundNoInterrupt("00"); break;
      case 1: SoundNoInterrupt("01"); break;
      case 2: SoundNoInterrupt("02"); break;
      case 3: SoundNoInterrupt("04"); break;
      case 4: SoundNoInterrupt("07"); break;
      case 5: SoundNoInterrupt("0D"); break;
      case 6: SoundNoInterrupt("10"); break;
      case 7: SoundNoInterrupt("11"); break;
      case 8: SoundNoInterrupt("12"); break;
      case 9: SoundNoInterrupt("14"); break;
      case 10: SoundNoInterrupt("24"); break;
      default: break;
     }
     SoundNoInterrupt("*");
     interrupts();
    }    
   }
            
  
 /*if (gb_sonido == true)
 {   
   if (gb_sonido_is_playing == true)
   {    
    if ((millis() - gb_time)<1000)
    {
     digitalWrite(pin_audio,HIGH); //Suena
     delayMicroseconds (718);
     digitalWrite(pin_audio,LOW);
     delayMicroseconds (718);
    }
    else
    {
     gb_sonido_is_playing = false;
     gb_sonido = false;
    }
   }
   else
   {
    gb_sonido_is_playing = true;
    gb_time = millis();
   }     
 }*/
}

void scrollscr(void)
{
  for (unsigned int i=VID_WIDTH; i < VID_WIDTH*VID_HEIGHT; i++)
    videomem[i-VID_WIDTH]=videomem[i];
  for (unsigned int i=VID_WIDTH*VID_HEIGHT - VID_WIDTH; i < VID_WIDTH*VID_HEIGHT; i++)
    videomem[i]=' ';
}

void chrout(char ascii)
{
  switch (ascii) {
    case 10:
      xpos=0;
      ypos++;
      if (ypos>=VID_HEIGHT) {
       scrollscr(); 
       xpos=0;
       ypos=VID_HEIGHT-1;
      }
      break;
    case 12:
      clrscr(' ');
      xpos=0;
      ypos=0;
      break;      
    default:
    if (ascii >= ' ' && ascii < 128) {
      videomem[xpos+ypos*VID_WIDTH] = ascii;
      xpos++;
      if (xpos>=VID_WIDTH) {
       xpos=0;
       ypos++;
       if (ypos>=VID_HEIGHT) {
        scrollscr(); 
        xpos=0;
        ypos=VID_HEIGHT-1;
       }
      }
    }
   }  
}

void printstr(char *string)
{
 while(*string)
   chrout(*string++);
}
void gotoxy(int x, int y)
{
  if (x < 0) x = 0;
  if (x > VID_WIDTH-1) x = VID_WIDTH-1;
  if (y < 0) y = 0;
  if (y > VID_HEIGHT-1) y = VID_HEIGHT-1;
  xpos = x;
  ypos = y;
}


/*
   Set up UART SPI master mode and timers for sync pulses
*/
void setup(void)
{
  cli();
  UBRR0 = 0; // must be zero before enabling the transmitter
  XCK0_DDR  |= _BV(XCK0); // set XCK pin as output to enable master mode
  UCSR0C     = _BV (UMSEL00) | _BV (UMSEL01);  // SPI master mode
  DDR_VID   |= _BV(VID_PIN);
  DDR_SYNC  |= _BV(SYNC_PIN);
  PORT_VID  &= ~_BV(VID_PIN);
  PORT_SYNC |= _BV(SYNC_PIN);
  TCCR1A     = _BV(COM1A1) | _BV(COM1A0) | _BV(WGM11); // inverted fast pwm mode on timer 2
  TCCR1B     = _BV(WGM13) | _BV(WGM12) | _BV(CS10);
  ICR1       = _NTSC_CYCLES_SCANLINE;
  OCR1A      = _CYCLES_HSYNC;
  OCR1B      = _NTSC_CYCLES_OUTPUT_START - 79;
  TIMSK1     = _BV(OCIE1B);
  TIMSK0     = 0; // turn timer0 off!
  SMCR       = _BV(SE); // allow IDLE sleep mode
  sei();
  //
  // Clear the video buffer and print out sample text
  //
#ifdef _use_gamepad_ataridb9
  pinMode(pin_ataridb9_up, INPUT_PULLUP);
  pinMode(pin_ataridb9_down, INPUT_PULLUP);
  pinMode(pin_ataridb9_left, INPUT_PULLUP);
  pinMode(pin_ataridb9_right, INPUT_PULLUP);
  pinMode(pin_ataridb9_a, INPUT_PULLUP);
  pinMode(pin_ataridb9_b, INPUT_PULLUP);
#endif

  pinMode (pin_audio, OUTPUT);

  ImagenDisco();
  antes_left = ahora_left = HIGH;
  antes_right = ahora_right = HIGH;
  antes_up= ahora_up = HIGH;
  antes_down = ahora_down = HIGH;
  antes_a = ahora_a = HIGH;
  antes_b = ahora_b = HIGH;
}
//
// Handle scanline timing
//
ISR(TIMER1_COMPA_vect)
{
  sei();
  asm("sleep\n"); // for clock synchronization during active lines
}
ISR(TIMER1_COMPB_vect)
{
  line_handler();
  scanline++;  
}
//
// Inactive scanlines
//
void blank_line(void)
{
  if (scanline == _NTSC_LINE_STOP_VSYNC)
  {
    OCR1A = _CYCLES_HSYNC;
  }
  else if ( scanline == _NTSC_LINE_MID - (VID_HEIGHT * CELL_HEIGHT) / 2)
  {
    TIMSK1       = _BV(OCIE1A) | _BV(OCIE1B);
    videoptr     = videomem;
    line_handler = &active_line;             
  }
  else if (scanline > _NTSC_LINE_FRAME)
  {
    OCR1A = _CYCLES_VSYNC;
    scanline = 0;
  }
}
//
// Active scanlines
//
void active_line(void)
{
  register char *charPtr;
  register int charCol;
  byte p ;
  static byte charRow = 0;

  UDR0 = 0;
  UCSR0B = _BV(TXEN0); // this spits out an idle bit (white pixel) so move it off the left side of the screen
  charPtr = videoptr;
  while ((UCSR0A & _BV (UDRE0)) == 0);
  UDR0 = 0;
  charCol = (int)&charROM + (charRow << 7); // overlap with some initialization
  while ((UCSR0A & _BV (UDRE0)) == 0);
  UDR0 = 0;
  while ((UCSR0A & _BV (UDRE0)) == 0);
  UDR0 = 0;
  while ((UCSR0A & _BV (UDRE0)) == 0);
  UDR0 = 0;
  p = VID_WIDTH;
  while ((UCSR0A & _BV (UDRE0)) == 0);
  UDR0 = 0;
  while (p--) // draw the character line
    UDR0 = pgm_read_byte_near(charCol + *charPtr++);
  while ((UCSR0A & _BV (TXC0)) == 0); // wait for pixels to shift out
  UCSR0B = 0;
  if (++charRow == CELL_HEIGHT)
  {
    charRow = 0;
    if (scanline == _NTSC_LINE_MID + (VID_HEIGHT * CELL_HEIGHT) / 2)
    {
      TIMSK1 = _BV(OCIE1B);
      line_handler = &blank_line;
      vblank = 1; // signal new frame
    }
    else
    {
      videoptr += VID_WIDTH;
    }
  }

}
/*
   Character output routines.
*/

void clrscr(byte val)
{
  for (int i = VID_WIDTH * VID_HEIGHT - 1; i >= 0; --i)
    videomem[i] = val;
}

/*void text_jj(char * cad, unsigned int x, unsigned int y)
{
 unsigned int i;
 char car;
 char auxCar;
 for (i=0;i< strlen(cad);i++)
 {
  car = cad[i];
  switch (cad[i])
  {
   case '┌': auxCar = 22; break;
   case '┐': auxCar = 28; break;
   case '─': auxCar = 26; break;
   case '┬': auxCar = 30; break;
   case '█': auxCar = 15; break;
   case '│': auxCar = 21; break;
   case '▒': auxCar = 127; break;
   case '└': auxCar = 19; break;
   case '┘': auxCar = 25; break;   
   case '├': auxCar = 23; break;   
   case '┤': auxCar = 29; break;         
   case '▀': auxCar = 3; break;
   default: auxCar= (car >= 127 || car < 0) ? auxCar = 0: auxCar = car;   
  break;    
  */
   /*case 218: auxCar = 22; break;//'┌'
   case 191: auxCar = 28; break;//'┐'
   case 196: auxCar = 26; break;//'─'
   case '┬': auxCar = 30; break;
   case 219: auxCar = 15; break;//'█'
   case 179: auxCar = 21; break;//'│'
   case 178: auxCar = 127; break;//'▒'
   case 192: auxCar = 19; break;//'└'
   case 217: auxCar = 25; break;   //'┘'
   case '├': auxCar = 23; break;   
   case '┤': auxCar = 29; break;         
   case '▀': auxCar = 3; break;
   default: auxCar= car; break;  */
/*  }
  videomem[(y*VID_WIDTH)+x] = auxCar;
  x++;
 }
}*/

//Carga la imagen del mando de FLASH a video
void ImagenDisco()
{
 unsigned int y,x;
 unsigned int index=0; //0*40
 unsigned int cont=0;   
 for (y = 0; y< 1000; y++)
 {
  videomem[y] = 0;
 }
 //30x25=750
 for (y=0;y<25;y++)
 {  
  for(x=4; x<34; x++)
  {   
   videomem[index+x]=pgm_read_byte(img_floppy+cont);
   cont++;
  }
  index += 40;
 }

 
  
 /* text_jj("┌───┬────────────────────┬───┐", 4, 0);
  text_jj("████│ ────────────────── │████", 4, 1);
  text_jj("█  █│ ────────────────── │█▒▒█", 4, 2);
  text_jj("█  █│ ────────────────── │█▒▒█", 4, 3);
  text_jj("████│ ────────────────── │████", 4, 4);
  text_jj("████│ ────────────────── │████", 4, 5);
  text_jj("████│ ────────────────── │████", 4, 6);
  text_jj("████│ ────────────────── │████", 4, 7);
  text_jj("████│ ────────────────── │████", 4, 8);
  text_jj("████│ ────────────────── │████", 4, 9);
  text_jj("████│ ────────────────── │████", 4, 10);
  text_jj("████└────────────────────┘████", 4, 11);
  text_jj("██████████████████████████████", 4, 12);
  text_jj("██████████████████████████████", 4, 13);
  text_jj("██████████████████████████████", 4, 14);
  text_jj("██████████████████████████████", 4, 15);
  text_jj("██▀▀▀███▒▒▒▒▒▒▒▒▒▒▒▒▒▒▒▒ ▀████", 4, 16);
  text_jj("██┌││██▒▒▒████▒▒▒▒▒▒▒▒▒▒  ████", 4, 17);
  text_jj("██│││██▒▒▒████▒▒▒▒▒▒▒▒▒▒  ████", 4, 18);
  text_jj("██│├┤██▒▒▒████▒▒▒▒▒▒▒▒▒▒  ████", 4, 19);
  text_jj("██│││██▒▒▒████▒▒▒▒▒▒▒▒▒▒  ████", 4, 20);
  text_jj("██│││██▒▒▒████▒▒▒▒▒▒▒▒▒▒  ████", 4, 21);
  text_jj("██└││██▒▒▒████▒▒▒▒▒▒▒▒▒▒  ████", 4, 22);
  text_jj("██▄▄▄██▒▒▒████▒▒▒▒▒▒▒▒▒▒  ████", 4, 23);
  text_jj(" ▀████▀▒▒▒▒▒▒▒▒▒▒▒▒▒▒▒▒▒__███▀", 4, 24);
  */

  /*unsigned int y,x;
    unsigned int index=200; //5*40
    unsigned int cont=0;
    //img_nespad
    for (y = 0; y< 1000; y++)
    videomem[y] = 0x01;

    for (y=5;y<19;y++)
    {
    for(x=11; x<29; x++)
    {
    //videomem[index+x]=pgm_read_byte_near(img_nespad+cont);
    videomem[index+x]=pgm_read_byte(img_nespad+cont);
    cont++;
    }
    index += 40;
    }
  */
  //for (int i = 0; i< 1000; i++)
  //{
  // //(int)&charROM + (charRow<<7); // overlap with some initialization
  // //videomem[i] = img_nespad[i];
  // videomem[i] = pgm_read_byte_near(img_nespad+i);
  //}
}

/*
   Run main loop
*/


void loop(void)
{
  if (vblank) // only update every frame
  {

   ahora_left = digitalRead(pin_ataridb9_left);
   if (antes_left != ahora_left)
   {
    antes_left = ahora_left;
    if (ahora_left == LOW)
    {     
     gb_track_player_select--;
     gb_track_player_select = (gb_track_player_select<0) ? 0: gb_track_player_select;
     SoundTrack();     
     ShowTrack();
     gb_playPause = true;
     ShowPlayPause();
    }
   }
   ahora_right = digitalRead(pin_ataridb9_right);
   if (antes_right != ahora_right)
   {
    antes_right = ahora_right;
    if (ahora_right == LOW)
    {    
     gb_track_player_select++;
     gb_track_player_select = (gb_track_player_select>10) ? 10: gb_track_player_select;
     SoundTrack();     
     ShowTrack();
     gb_playPause = true;
     ShowPlayPause();
    }
   }   
   ahora_up = digitalRead(pin_ataridb9_up);
   if (antes_up != ahora_up)
   {
    antes_up = ahora_up;
    if (ahora_up == LOW)
    {      
     SoundVol(true);     
     //Genera1000HzInterrupt();
     gotoxy(14,5);
     printstr(" Vol + ");     
    }
   }
   ahora_down = digitalRead(pin_ataridb9_down); 
   if (antes_down != ahora_down)
   { 
    antes_down = ahora_down;   
    if (ahora_down == LOW)
    {     
     SoundVol(false);     
     //Genera1000HzNoInterrupt();
     gotoxy(14,5);     
     printstr(" Vol - ");
    }
   }

   ahora_a= digitalRead(pin_ataridb9_a);
   if (antes_a != ahora_a)
   {
    antes_a = ahora_a;
    if (ahora_a == LOW)
    {
     gb_playPause = !gb_playPause;
     ShowPlayPause();
     SoundPlayPause();     
    }
   }

   ahora_b= digitalRead(pin_ataridb9_b);
   if (antes_b != ahora_b)
   {
    antes_b = ahora_b;
    if (ahora_b == LOW)
    {
     gb_use_video_sound = !gb_use_video_sound;
     ShowInterrupt();
    }
   }
   
   
   
   //text_jj(" Track ' + gb_track_player_select.toString()+'  ',14,3);
   //text_jj(' Vol ' + gb_vol_player_select.toString()+'% ',14,5);   
   //text_jj(" Jaime ",14,7);
    

    vblank = 0;
  }

  //PollSound();
}
