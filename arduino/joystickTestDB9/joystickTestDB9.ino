//
// Output NTSC video using the UART in SPI master mode on Arduino Uno.
// 40x25 character buffer is rasterized and scanned out in real-time.
// 320X200 pixels out of 1000 RAM bytes and 1K Flash character ROM.
// VIDEO on pin 1 (470 ohm resistor), SYNC on pin 9 (1K ohm resistor).
// Original source Dave Schmenk
// Mod by ackerman (Jaime Jose Gavin Sierra)

  #define pin_ataridb9_up 14
  #define pin_ataridb9_down 15
  #define pin_ataridb9_left 16
  #define pin_ataridb9_right 17
  //boton 2
  #define pin_ataridb9_a 4
  //boton 1
  #define pin_ataridb9_b 5
 
//
// Timing settings for NTSC
//
#define _CYCLES_PER_US          (F_CPU / 1000000)
#define _TIME_HSYNC             4.7
#define _TIME_VSYNC             58.85
#define _TIME_ACTIVE            46
#define _CYCLES_VSYNC           ((_TIME_VSYNC * _CYCLES_PER_US) - 1)
#define _CYCLES_HSYNC           ((_TIME_HSYNC * _CYCLES_PER_US) - 1)
#define _NTSC_TIME_SCANLINE      63.55
#define _NTSC_TIME_OUTPUT_START  12
#define _NTSC_LINE_FRAME         262
#define _NTSC_LINE_START_VSYNC   0
#define _NTSC_LINE_STOP_VSYNC    3
#define _NTSC_LINE_DISPLAY       216
#define _NTSC_LINE_MID           ((_NTSC_LINE_FRAME - _NTSC_LINE_DISPLAY)/2 + _NTSC_LINE_DISPLAY/2 + _NTSC_LINE_STOP_VSYNC)
#define _NTSC_CYCLES_SCANLINE    ((_NTSC_TIME_SCANLINE * _CYCLES_PER_US) - 1)
#define _NTSC_CYCLES_OUTPUT_START ((_NTSC_TIME_OUTPUT_START * _CYCLES_PER_US) - 1)
//
// video = UART SPI TX
//
#define PORT_VID     PORTD
#define	DDR_VID     DDRD
#define	VID_PIN     1
#define XCK0_DDR     DDRD
#define XCK0         4
//
// sync = OC1A
//
#define PORT_SYNC    PORTB
#define DDR_SYNC     DDRB
#define SYNC_PIN     1
//
// video buffer
//
#define VID_WIDTH    40
#define VID_HEIGHT   25
#define CELL_WIDTH   8
#define CELL_HEIGHT  8
byte xpos=0;
byte ypos=0;
char videomem[VID_WIDTH*VID_HEIGHT];
//
// rendering values
//
char *videoptr = videomem;
int scanline=0;
void (*line_handler)(void) = &blank_line;
volatile byte vblank=0;
//
// character definitions
//
PROGMEM const byte charROM [1024] = {
0x00,0xFF,0xFF,0xFF,0xFC,0x3F,0xFF,0xFF,0xE0,0x0F,0xFF,0xFF,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0x00,
0x00,0xFF,0xFF,0xFF,0xF0,0x1F,0xFF,0xFF,0x80,0x07,0xFF,0xFF,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0x00,
0x00,0xFF,0xFF,0xFF,0xC0,0x0F,0xFF,0xFC,0x00,0x03,0xFF,0xFF,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0x00,
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0x00,0xFF,0xFC,0x00,0x00,0x00,0x1F,0xF0,0x00,0x08,0x07,0xF0,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0x00
};

PROGMEM const byte img_nespad[1000] ={
0x01,0x01,0x01,0x01,0x01,0x01,0x01,0x01,0x01,0x01,0x01,0x01,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0x01,
0x01,0x01,0x01,0x01,0x01,0x01,0x01,0x01,0x01,0x01,0x01,0x01,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0x01,
0x01,0x01,0x01,0x01,0x01,0x01,0x01,0x01,0x01,0x01,0x01,0x01,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0x01,
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0x01,0x01,0x01,0x01,0x01,0x01,0x01,0x01,0x01,0x01,0x01,0x01,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0x01
};

/*
 * Set up UART SPI master mode and timers for sync pulses
 */
void setup(void)
{
  cli();
  UBRR0 = 0; // must be zero before enabling the transmitter
  XCK0_DDR  |= _BV(XCK0); // set XCK pin as output to enable master mode
  UCSR0C     = _BV (UMSEL00) | _BV (UMSEL01);  // SPI master mode
  DDR_VID   |= _BV(VID_PIN);
  DDR_SYNC  |= _BV(SYNC_PIN);
  PORT_VID  &= ~_BV(VID_PIN);
  PORT_SYNC |= _BV(SYNC_PIN);
  TCCR1A     = _BV(COM1A1) | _BV(COM1A0) | _BV(WGM11); // inverted fast pwm mode on timer 2
  TCCR1B     = _BV(WGM13) | _BV(WGM12) | _BV(CS10);
  ICR1       = _NTSC_CYCLES_SCANLINE;
  OCR1A      = _CYCLES_HSYNC;
  OCR1B      = _NTSC_CYCLES_OUTPUT_START - 79;
  TIMSK1     = _BV(OCIE1B);
  TIMSK0     = 0; // turn timer0 off!
  SMCR       = _BV(SE); // allow IDLE sleep mode
  sei();
  //
  // Clear the video buffer and print out sample text
  //
    pinMode(pin_ataridb9_up,INPUT_PULLUP);
    pinMode(pin_ataridb9_down,INPUT_PULLUP);
    pinMode(pin_ataridb9_left,INPUT_PULLUP);
    pinMode(pin_ataridb9_right,INPUT_PULLUP);    
    pinMode(pin_ataridb9_a,INPUT_PULLUP);    
    pinMode(pin_ataridb9_b,INPUT_PULLUP);    
  
  ImagenMando();
}
//
// Handle scanline timing
//
ISR(TIMER1_COMPA_vect)
{
  sei();
  asm("sleep\n"); // for clock synchronization during active lines
}
ISR(TIMER1_COMPB_vect)
{
  line_handler();
  scanline++;
}
//
// Inactive scanlines
//
void blank_line(void)
{
  if (scanline == _NTSC_LINE_STOP_VSYNC)
  {
    OCR1A = _CYCLES_HSYNC;
  }
  else if ( scanline == _NTSC_LINE_MID - (VID_HEIGHT*CELL_HEIGHT)/2)
  {
    TIMSK1       = _BV(OCIE1A) | _BV(OCIE1B);
    videoptr     = videomem;
    line_handler = &active_line;
  }
  else if (scanline > _NTSC_LINE_FRAME)
  {
    OCR1A = _CYCLES_VSYNC;
    scanline = 0;
  }
}
//
// Active scanlines
//
void active_line(void)
{
  register char *charPtr;
  register int charCol;
  byte p ;
  static byte charRow = 0;  

  UDR0 = 0;
  UCSR0B = _BV(TXEN0); // this spits out an idle bit (white pixel) so move it off the left side of the screen
  charPtr = videoptr; 
  while ((UCSR0A & _BV (UDRE0)) == 0);
  UDR0 = 0;
  charCol = (int)&charROM + (charRow<<7); // overlap with some initialization
  while ((UCSR0A & _BV (UDRE0)) == 0);
  UDR0 = 0;
  while ((UCSR0A & _BV (UDRE0)) == 0);
  UDR0 = 0;
  while ((UCSR0A & _BV (UDRE0)) == 0);
  UDR0 = 0;
  p = VID_WIDTH;
  while ((UCSR0A & _BV (UDRE0)) == 0);
  UDR0 = 0;
  while (p--) // draw the character line
    UDR0 = pgm_read_byte_near(charCol + *charPtr++);
  while ((UCSR0A & _BV (TXC0)) == 0); // wait for pixels to shift out
  UCSR0B = 0;
  if (++charRow == CELL_HEIGHT)
  {
    charRow = 0;
    if (scanline == _NTSC_LINE_MID + (VID_HEIGHT*CELL_HEIGHT)/2)
    {
      TIMSK1 = _BV(OCIE1B);
      line_handler = &blank_line;
      vblank=1; // signal new frame
    }
    else
    {
      videoptr += VID_WIDTH;
    }
  }
}
/*
 * Character output routines.
 */

void clrscr(byte val)
{
  for (int i = VID_WIDTH*VID_HEIGHT-1; i >= 0; --i)
    videomem[i] = val;
}

void ImagenMando()
{ 
 for (int i = 0; i< 1000; i++)
 {
  //(int)&charROM + (charRow<<7); // overlap with some initialization
  //videomem[i] = img_nespad[i];
  videomem[i] = pgm_read_byte_near(img_nespad+i);
 } 
}

/*
 * Run main loop
 */


void loop(void)
{
  byte i;

  if (vblank) // only update every frame
  {   
   videomem[415] = (digitalRead(pin_ataridb9_up)==LOW) ? 0x5D:0x32;
   videomem[537] = (digitalRead(pin_ataridb9_down)==LOW) ? 0x2B:0x5E;

   videomem[495] = (digitalRead(pin_ataridb9_left)==LOW) ? 0x5D:0x4F;  
   videomem[458] = (digitalRead(pin_ataridb9_right)==LOW) ? 0x5D:0x42; 
      
   videomem[306] = (digitalRead(pin_ataridb9_a)==LOW) ? 0x2B:0x11; 
   videomem[345] = (digitalRead(pin_ataridb9_b)==LOW) ? 0x2B:0x1D;
   
   vblank=0;
  }
}
